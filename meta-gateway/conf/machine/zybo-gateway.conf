## meta-gateway/conf/machine/zybo-gateway.conf
```bitbake
#@TYPE: Machine
#@NAME: zybo-gateway
#@DESCRIPTION: Machine support for zybo-gateway project.
#

require conf/machine/include/tune-zynq.inc
require conf/machine/include/machine-xilinx-default.inc
require conf/machine/include/machine-xilinx-board.inc

PREFERRED_PROVIDER_virtual/kernel ?= "linux-yocto"
PREFERRED_PROVIDER_linux-libc-headers ?= "linux-libc-headers-yocto"
PREFERRED_PROVIDER_virtual/bootloader ?= "u-boot"
PREFERRED_VERSION_linux-yocto = "4.8%"

MACHINE_FEATURES = "ext2 vfat usbhost usbgadget keyboard sdio"
SERIAL_CONSOLE = "115200 ttyPS0"

MACHINE_ESSENTIAL_EXTRA_RDEPENDS += "device-tree"
MACHINE_ESSENTIAL_EXTRA_RDEPENDS += "axi-gpio-mod"
# -----------  Modifications Modules ------------------------
MACHINE_ESSENTIAL_EXTRA_RDEPENDS += "hello-mod"
#MACHINE_ESSENTIAL_EXTRA_RDEPENDS += "vdmatest-mod"
#MACHINE_ESSENTIAL_EXTRA_RDEPENDS += "dmatestlinux-mod"
MACHINE_ESSENTIAL_EXTRA_RDEPENDS += "dma-proxy-mod"
MACHINE_ESSENTIAL_EXTRA_RDEPENDS += "passthrough-mod"
# --------------------------------------------------------
MACHINE_DEVICETREE = " \
		zynq-7000.dtsi \
		skeleton.dtsi \
		pl.dtsi \	
		pcw.dtsi \
		system-top.dts \
		"

UBOOT_MACHINE = "zynq_zybo_config"
SPL_BINARY = "spl/boot.bin"
FORCE_PS7INIT = "zybo"

EXTRA_IMAGEDEPENDS += "virtual/bitstream"

IMAGE_BOOT_FILES += "boot.bin \
		${MACHINE}.dtb \
		bitstream \
		"
```
